## components/wifi/Kconfig
```kconfig
menu "WiFi Configuration"

    config WIFI_SSID
        string "WiFi SSID"
        default ""
        help
            SSID (network name) of your Access Point.
            This field cannot be empty for the station to connect.

    config WIFI_PASSWORD
        string "WiFi Password"
        default ""
        help
            WiFi password (WPA or WPA2).
            Leave empty if the network is open (not recommended).

endmenu
```
